#include "Keypad.h"
#include "Encoder.h"
#include <SPI.h>
#include <Wire.h>
#include <SD.h>
#include "U8glib.h"

//#include <SD.h>

U8GLIB_SSD1306_128X64 u8g(U8G_I2C_OPT_DEV_0|U8G_I2C_OPT_NO_ACK|U8G_I2C_OPT_FAST);	// Fast I2C / TWI 


#define SD_CS_PIN 18

#define SCREEN_WIDTH 128  // OLED display width, in pixels
#define SCREEN_HEIGHT 64  // OLED display height, in pixels
#define FONT_SIZE_UNIT 8
#define FONT_SCALE 2

const byte COLS = 3;
const byte ROWS = 4;
const byte MAX_NUMBER_OF_KEYS_PRESSED = 4;

byte rowPins[ROWS] = { 7, 8, 9, 10 };  // connect to the row pinouts of the keypad
byte colPins[COLS] = { 4, 5, 6 };      // connect to the column pinouts of the keypad

Keypad keypad(COLS, ROWS, MAX_NUMBER_OF_KEYS_PRESSED, rowPins, colPins);

byte NUM_OF_OPTIONS = 0;
// const String menuOptions[] = { "Work", "Personal", "Emails", "Spotify", "Passwords" };
char menuOptions[5][16];
char infoList[12][20];



byte loadedOptions = -1;


byte menuIndex = 0;
byte layerIndex = 0;
byte pageIndex = 0;

// struct shortcut {
//   char key;
//   char name[20];
// };

// const shortcut shortcuts[][ROWS * COLS] PROGMEM = {
//   {
//     { '1', "Unlock PC" },
//     { '2', "Win Password" },
//     { '3', "Visual Studio" },
//     { '4', "VS Code" },
//     { '5', "Remote Desktop" },
//     { '6', "Open PRU3WA" },
//     { '7', "Open PRS62" },
//     { '8', "Teams" },
//     { 'D', "Sourcetree" },
//     { 'M', "Create MR" },
//     { 'H', "Create Ticket" },
//     { 'S', "Open Code" },
//   },
//   {
//     { '1', "Unlock PC" },
//     { '2', "League of legends" },
//     { '3', "Empty" },
//     { '4', "Empty" },
//     { '5', "Empty" },
//     { '6', "Empty" },
//     { '7', "Empty" },
//     { '8', "Empty" },
//     { 'D', "Empty" },
//     { 'M', "Empty" },
//     { 'H', "Empty" },
//     { 'S', "Empty" },
//   },
//   {
//     { '1', "Unlock PC" },
//     { '2', "League of legends" },
//     { '3', "Empty" },
//     { '4', "Empty" },
//     { '5', "Empty" },
//     { '6', "Empty" },
//     { '7', "Empty" },
//     { '8', "Empty" },
//     { 'D', "Empty" },
//     { 'M', "Empty" },
//     { 'H', "Empty" },
//     { 'S', "Empty" },
//   },
//   {
//     { '1', "Unlock PC" },
//     { '2', "League of legends" },
//     { '3', "Empty" },
//     { '4', "Empty" },
//     { '5', "Empty" },
//     { '6', "Empty" },
//     { '7', "Empty" },
//     { '8', "Empty" },
//     { 'D', "Empty" },
//     { 'M', "Empty" },
//     { 'H', "Empty" },
//     { 'S', "Empty" },
//   },
//   {
//     { '1', "Unlock PC" },
//     { '2', "League of legends" },
//     { '3', "Empty" },
//     { '4', "Empty" },
//     { '5', "Empty" },
//     { '6', "Empty" },
//     { '7', "Empty" },
//     { '8', "Empty" },
//     { 'D', "Empty" },
//     { 'M', "Empty" },
//     { 'H', "Empty" },
//     { 'S', "Empty" },
//   }
// };

String previousPressedKeys = "";
char displayedKey = 0;
// 'KIKI', 128x64px
const unsigned char kiki_bitmapKIKI[] PROGMEM = {
  0x00, 0x00, 0x00, 0x00, 0x00, 0x00, 0x00, 0x00, 0x00, 0x00, 0x00, 0x00, 0x00, 0x00, 0x00, 0x00,
  0x00, 0x00, 0x00, 0x00, 0x00, 0x80, 0x00, 0x00, 0x00, 0x00, 0x00, 0x00, 0x00, 0x00, 0x00, 0x00,
  0x00, 0x03, 0xf8, 0x02, 0x01, 0x80, 0x3f, 0xc0, 0x00, 0x00, 0x00, 0x00, 0x00, 0x00, 0x00, 0x00,
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  0x00, 0x00, 0x00, 0x00, 0x00, 0x00, 0x00, 0x00, 0x00, 0x00, 0x00, 0x00, 0x00, 0x00, 0x00, 0x00
};
// 'KIKI2', 128x64px
const unsigned char kiki_bitmapKIKI2[] U8G_PROGMEM = {
  0x00, 0x00, 0x00, 0x00, 0x00, 0x00, 0x00, 0x00, 0x00, 0x00, 0x00, 0x00, 0x00, 0x00, 0x00, 0x00,
  0x00, 0x00, 0x00, 0x00, 0x00, 0x00, 0x00, 0x00, 0x00, 0x08, 0x00, 0x00, 0x00, 0x00, 0x00, 0x00,
  0x00, 0x00, 0x00, 0x00, 0x00, 0x00, 0x01, 0xf0, 0x08, 0x18, 0x0f, 0xe0, 0x00, 0x00, 0x00, 0x00,
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  0x00, 0x00, 0x00, 0x00, 0x00, 0x00, 0x00, 0x00, 0x00, 0x00, 0x00, 0x00, 0x00, 0x00, 0x00, 0x00
};

// // Array of all bitmaps for convenience. (Total bytes used to store images in PROGMEM = 2080)
const int kiki_bitmapallArray_LEN = 2;
const unsigned char* kiki_bitmapallArray[2] = {
  kiki_bitmapKIKI,
  kiki_bitmapKIKI2
};


Encoder encoder(A2, A3, A1);

unsigned int counter = 0;
bool timer1 = 0;

File menuFile;
File infoFile;

void u8g_prepare(void) {
  u8g.setFont(u8g_font_6x10);
  u8g.setFontRefHeightExtendedText();
  u8g.setDefaultForegroundColor();
  u8g.setFontPosTop();
}

void setup() {
  Serial.begin(9600);

  delay(3000);

  Serial.println("Initializing SD card...");

  while (!SD.begin(SD_CS_PIN)) {
    Serial.println("SD init failed, retrying...");
  }
  Serial.println("SD init done");

  Serial.println("Loading menu...");

  menuFile = SD.open("menu.bin", FILE_READ);
  if (menuFile) {
    while (menuFile.available()) {
      menuFile.read(menuOptions[NUM_OF_OPTIONS++], 16);
      Serial.println(menuOptions[NUM_OF_OPTIONS - 1]);
    }
    menuFile.close();
  } else {
    Serial.println("Error loading menu!");
  }

  keypad.initKeypad();
  encoder.initEncoder();
  u8g_prepare();
  renderMenu();
}


void renderMenu() {
  u8g.firstPage();
  do {
    if (layerIndex == 0) {
      u8g.drawRFrame(5, (SCREEN_HEIGHT - FONT_SCALE * FONT_SIZE_UNIT) / 2 - 5, SCREEN_WIDTH - 10, FONT_SCALE * FONT_SIZE_UNIT + 8, 5);
      u8g.setScale2x2();
      u8g.drawStr(5, (SCREEN_HEIGHT - FONT_SCALE * FONT_SIZE_UNIT) / 4 - 1, menuOptions[menuIndex]);

      if (menuIndex > 0) {
        u8g.drawStr(5, ((SCREEN_HEIGHT - FONT_SCALE * FONT_SIZE_UNIT) / 2 - FONT_SCALE * FONT_SIZE_UNIT - 8) / 2, menuOptions[menuIndex - 1]);
      }
      if (menuIndex < NUM_OF_OPTIONS - 1) {
        u8g.drawStr(5, ((SCREEN_HEIGHT + FONT_SCALE * FONT_SIZE_UNIT) / 2 + 6) / 2, menuOptions[menuIndex + 1]);
      }
      u8g.undoScale();
    } else if (layerIndex == 1) {
      renderPage();
    }
  } while (u8g.nextPage());
}

void renderPage() {
  u8g.undoScale();

  if (loadedOptions != menuIndex) {
    Serial.println("Loading info...");
    char path[] = "opt_X.bin";
    path[4] = menuIndex + 49;
    infoFile = SD.open(path, FILE_READ);
    if (infoFile) {
      infoFile.read(infoList, 20 * 12);
      infoFile.close();
    } else {
      Serial.println("Error loading info!");
      return;
    }
    loadedOptions = menuIndex;
  }

  for (byte i = 0; i < 6; i++) {
    u8g.drawStr(0, i * (FONT_SIZE_UNIT + 2), "x");
    u8g.drawStr(16, i * (FONT_SIZE_UNIT + 2), infoList[pageIndex + i]);
  }
}

void loop() {
  if (timer1) {
    counter++;
  } else if (counter) {
    counter = 0;
  }
  String x = String(keypad.getPressedKeys());
  char encoderValue = encoder.getEncoderEvent();
  if (encoderValue) {
    if (encoderValue == '+') {
      if (layerIndex && pageIndex < ROWS * COLS - 7) {
        pageIndex++;
      } else if (!layerIndex && menuIndex < NUM_OF_OPTIONS - 1) {
        menuIndex++;
      }
    } else if (encoderValue == '-') {
      if (layerIndex && pageIndex > 0) {
        pageIndex--;
      } else if (!layerIndex && menuIndex > 0) {
        menuIndex--;
      }
    } else if (encoderValue == 'B') {
      layerIndex = !layerIndex;
      pageIndex = 0;
    }
    renderMenu();
  }
  if (x != previousPressedKeys) {

    // if (x == "M" && menuIndex < NUM_OF_OPTIONS - 1) {
    //   menuIndex++;
    // } else if (x == "D" && menuIndex > 0) {
    //   menuIndex--;
    // }
    // renderMenu();
    if (x.length()) {
      timer1 = 1;
      displayedKey = x[0];
      u8g.firstPage();
      do {
        u8g.drawBitmapP(0, 0, 128 / 8, 64, kiki_bitmapallArray[1]);
      } while (u8g.nextPage());
    }
    Serial.println("Key Event");
    previousPressedKeys = x;
  }

  if (counter > 300) {
    u8g.firstPage();
    do {
      u8g.drawBitmapP(0, 0, 128 / 8, 64, kiki_bitmapallArray[0]);
      if (displayedKey) {
        u8g.setScale2x2();
        char key[2] = " ";
        key[0] = displayedKey;
        u8g.drawStr(50, 5, key);
        u8g.undoScale();
      }
    } while (u8g.nextPage());
    timer1 = 0;
  }
}
